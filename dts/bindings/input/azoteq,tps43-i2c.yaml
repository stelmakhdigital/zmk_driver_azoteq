## dts/bindings/input/azoteq,tps43-i2c.yaml
```yaml
description: |
  Драйвер сенсора тачпада Azoteq TPS43 по интерфейсу I2C

compatible: "azoteq,tps43"

include: ["i2c-device.yaml", "azoteq,tps43-common.yaml"]
```
